// SPDX-License-Identifier: GPL-2.0+
/*
 * Test device tree file for dtoc, with a single node for a driver which uses
 * the dev_prop helpers
 *
 * Copyright 2026 Simon Glass <sjg@chromium.org>
 */

/dts-v1/;

/ {
	#address-cells = <1>;
	#size-cells = <1>;

	clk: clock-controller {
		bootph-all;
		compatible = "sandbox,clk";
		#clock-cells = <1>;
	};

	dev_prop-a {
		bootph-all;
		compatible = "test,dev_prop";
		reg = <0x1000 0x10>;
		max-frequency = <50000000>;
		rw-array = <1 2 3 4 5 6 7 8 9>;
		clocks = <&clk 3>;
	};
};
